## fs/Config.in
```kconfig
menu "Filesystem images"

choice
    prompt "Root FS skeleton"

config BR2_ROOTFS_SKELETON_DEFAULT
    bool "default target skeleton"
    help
      Use default target skeleton

config BR2_ROOTFS_SKELETON_CUSTOM
    bool "custom target skeleton"
    help
      Use custom target skeleton.

endchoice

if BR2_ROOTFS_SKELETON_CUSTOM
config BR2_ROOTFS_SKELETON_CUSTOM_PATH
    string "custom target skeleton path"
    default "fs/skeleton"
    help
      Path custom target skeleton.
endif


source "fs/cloop/Config.in"
source "fs/cpio/Config.in"
source "fs/cramfs/Config.in"
source "fs/ext2/Config.in"
source "fs/initramfs/Config.in"
source "fs/iso9660/Config.in"
source "fs/jffs2/Config.in"
source "fs/romfs/Config.in"
source "fs/squashfs/Config.in"
source "fs/tar/Config.in"
source "fs/ubifs/Config.in"
source "fs/yaffs2/Config.in"
source "fs/ext4/Config.in"

endmenu
```

## fs/ext4a/Config.in
```kconfig
config BR2_TARGET_ROOTFS_EXT4A
	bool "android ext4 root filesystem"
	help
	  Build an android ext4 root filesystem

config BR2_TARGET_ROOTFS_EXT4A_SIZE
	int "size in Mega bytes (leave at 0 for auto calculation)"
	depends on BR2_TARGET_ROOTFS_EXT4A
	default 0
```

## package/broadcom-bluetooth/Config.in
```kconfig
config BR2_PACKAGE_BROADCOM_BLUETOOTH
	bool "broadcom-bluetooth"
	help
	  broadcom-bluetooth is a small utility for downloading a patchram file
	  in HCD format to Broadcom Bluetooth based silicon and combo chips and
	  other utility functions
	
	  https://github.com/pengphei/broadcom-bluetooth
```

## package/cc-tool/Config.in
```kconfig
config BR2_PACKAGE_CC_TOOL
	bool "cc-tool"
	depends on BR2_INSTALL_LIBSTDCPP
	depends on BR2_USE_WCHAR # boost
	select BR2_PACKAGE_BOOST
	select BR2_PACKAGE_BOOST_FILESYSTEM
	select BR2_PACKAGE_BOOST_REGEX
	select BR2_PACKAGE_BOOST_SYSTEM
	select BR2_PACKAGE_BOOST_PROGRAM_OPTIONS
	select BR2_PACKAGE_BOOST_ROOT
	select BR2_PACKAGE_BOOST_THREAD
	select BR2_PACKAGE_LIBUSB
	select BR2_PACKAGE_LIBUSB_COMPAT
	
	help
	  cc-tool provides support for Texas Instruments CC Debugger.
	  Works for Linux OS in order to program 8051-based System-On-Chip devices: 
	  CC254x CC253x CC243x CC251x CC111x

	  http://sourceforge.net/projects/cctool/
```
